/dts-v1/;

/*
 * This file is suitable for testing on the host device as it uses a local
 * file. To set it up:
 *
 *    dd if=/dev/zero of=/tmp/testfw bs=1M count=3
 *    dtc test.dts -o /var/lib/fwupd/system.dtb
 */

/ {
	compatible = "pine64,rockpro64-v2.1";

	chosen {
		fwupd {
			compatible = "pine64,rockpro64-v2.1";

			firmware {
				compatible = "fwupd,vbe-simple";
				cur-version = "1.2.3";
				bootloader-version = "2022.01";
				storage = "/tmp/testfw";
				area-start = <0x100000>;
				area-size = <0x100000>;
				skip-offset = <0x8000>;
				part-uuid = "62db0ccf-03";
				part-id = "3";
			};
		};
	};
};
